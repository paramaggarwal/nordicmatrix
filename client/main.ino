/**
 * LED Matrix control via Mirf.
 *
 * Mirf Pins:
 * MISO -> 12
 * MOSI -> 11
 * SCK -> 13
 * CE -> 8
 * CSN -> 7
 *
 */

#include <SPI.h>
#include <Mirf.h>
#include <nRF24L01.h>
#include <MirfHardwareSpiDriver.h>
#include <avr/pgmspace.h>
#include <EEPROM.h>

#define DELAY 100
#define SPEED 20

const byte clockPin = 2;
const byte dataPin = 3;
const byte latchPin = 4;

byte displayBuffer[8]= {0};
byte bufferLength = 0;

//byte arrow[8]={0x18,0x3C,0x66,0xDB,0x18,0x18,0x18,0x18};

prog_uchar fontDefinitions[475] PROGMEM = {
  0x00,0x00,0x00,0x00,0x00,/*space*/ // is 32 in ASCII
  0x00,0xF6,0xF6,0x00,0x00,/*!*/
  0x00,0xE0,0x00,0xE0,0x00,/*"*/
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  0x00,0x00,0x06,0x06,0x00,/*.*/
  0x02,0x0C,0x10,0x60,0x80,/*/*/
  0x7C,0x8A,0x92,0xA2,0x7C,/*0*/
  0x00,0x42,0xFE,0x02,0x00,/*1*/
  0x42,0x86,0x8A,0x92,0x62,/*2*/
  0x44,0x82,0x92,0x92,0x6C,/*3*/
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  0x00,0x10,0x6C,0x82,0x82,/*{*/
  //0x00,0x00,0xFF,0x00,0x00,/*|*/
  0x04,0x02,0xFF,0x02,0x04,/*|, arrow*/
  0x82,0x82,0x6C,0x10,0x00,/*}*/
  0x08,0x10,0x18,0x08,0x10/*~*/
};

void setup(){
  Serial.begin(9600);

  pinMode(clockPin, OUTPUT);
  pinMode(dataPin, OUTPUT);
  pinMode(latchPin, OUTPUT);

  // Mirf.payload = 16;  
  // Mirf.channel = 10;

  Mirf.spi = &MirfHardwareSpi;
  Mirf.init();
  Mirf.setRADDR((byte *)"clie1");    
  Mirf.config();

  Serial.println("Beginning..."); 
}


void loop(){
  boolean dataReceived = false;

  while (!Mirf.isSending() && !Mirf.dataReady()) { //No new data incoming
    displayTweet();
    addSpace();
  }

  do {
    //Serial.println("Waiting");

  if(!Mirf.isSending() && Mirf.dataReady()) {

      byte data[Mirf.payload];  
      Mirf.getData(data);

      Serial.println("Got packet");

      for(int i=0; i<14; i++) {
        if(EEPROM.read( (data[0]*14) + i ) != data[i+1])
          EEPROM.write( (data[0]*14) + i, data[i+1] );
      }

      Serial.println("Saved packet to buffer");

      if (data[15] == 0x00) {
        bufferLength = 14; 
      } else if (data[15] == 0x55) {
        bufferLength = bufferLength + 14;  
      } else if (data[15] == 0xAA) {
        bufferLength = bufferLength + 14;
        if(bufferLength == (data[0]+1)*14)
          dataReceived = true;  
      }
      
      if(EEPROM.read(140) != bufferLength)
        EEPROM.write(140, bufferLength);

    }

  } while (dataReceived != true);

  Serial.println("Received complete tweet");
  //newTweetTone();
  //Serial.println(tweetBuffer);
  
  
  
}

void scrollBufferLeft() {
  for(int i=7; i>=0; i--) {
    displayBuffer[i+1] = displayBuffer[i];
  }
}

void addCharSliceToBuffer(byte c, byte pos) {
  displayBuffer[0] = pgm_read_byte_near(fontDefinitions + ((c - 32) * 5) + pos);
}

void displayTweet() {
  for(int k = 0; k < EEPROM.read(140); k++) {
    for(int j = 0; j < 5; j++) {
      addCharSliceToBuffer(EEPROM.read((int) k), j);
      for(int i=0; i < SPEED; i++) drawImage(displayBuffer);
      scrollBufferLeft();
    }
    addCharSliceToBuffer(' ', 0);
    for(int i=0; i < SPEED; i++) drawImage(displayBuffer);
    scrollBufferLeft();
    
    if(!Mirf.isSending() && Mirf.dataReady()) return; //Break if new data incoming 
  }
}

void addSpace() {
  for(int j=0; j<16; j++) {
    addCharSliceToBuffer(' ', 0);
    for(int i=0; i < SPEED; i++) drawImage(displayBuffer);
    scrollBufferLeft();
    
    if(!Mirf.isSending() && Mirf.dataReady()) return; //Break if new data incoming 
  }
  
}

void drawImage(byte * matrix) {
  for(int i=0; i<8; i++) {
    for(int j=0; j<8; j++) { 
      digitalWrite(clockPin, LOW);
      digitalWrite(dataPin, (matrix[i]) & (1<<j) );
      digitalWrite(clockPin, HIGH);
    }

    for(int j=7; j>=0; j--) { 
      digitalWrite(clockPin, LOW);
      digitalWrite(dataPin, (~(1<<i)) & (1<<j) );
      digitalWrite(clockPin, HIGH);
    }

    digitalWrite(latchPin,LOW);
    digitalWrite(latchPin,HIGH);
  } 
}

void newTweetTone() {
  tone(8, 2000, DELAY);
  delay(DELAY);
  tone(8, 2200, DELAY);
  delay(DELAY);
  tone(8, 2400, DELAY);
  delay(DELAY);

  delay(DELAY);
  tone(8, 2400, DELAY);
  delay(DELAY);
}
